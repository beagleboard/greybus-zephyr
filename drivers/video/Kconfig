## drivers/video/Kconfig
```kconfig
config FAKE_CAMERA
	bool "Fake Camera Driver"
	default n
	help
	  Enable the fake camera driver for simulation testing
```

## dts/bindings/greybus/zephyr,greybus-bundle-camera.yaml
```yaml
# Copyright (c) 2026, Pavithra CP BeagleBoard.org
# SPDX-License-Identifier: Apache-2.0

description: Greybus Bundle for Camera class

compatible: "zephyr,greybus-bundle-camera"

include: [base.yaml]

properties:
  cameras:
    type: phandles
    description: Camera devices in the bundle
```

## dts/bindings/greybus/zephyr,greybus-bundle-lights.yaml
```yaml
# Copyright (c) 2025, Ayush Singh BeagleBoard.org
# SPDX-License-Identifier: Apache-2.0

description: Greybus Bundle for class Lights

compatible: "zephyr,greybus-bundle-lights"

include: [base.yaml]

properties:
  lights:
    type: phandles
    description: Lights in the bundle

  led-strips:
    type: phandles
    description: LED strips in the bundle
```

## dts/bindings/greybus/zephyr,greybus-bundle-vibrator.yaml
```yaml
# Copyright (c) 2025, Ayush Singh BeagleBoard.org
# SPDX-License-Identifier: Apache-2.0

description: Greybus Bundle for class Vibrator

compatible: "zephyr,greybus-bundle-vibrator"

include: [base.yaml]

properties:
  vibrators:
    type: phandles
    description: Vibrators in the bundle
```

## samples/basic/boards/beagleconnect_freedom_cc1352p7.conf
```kconfig
# Copyright (c) 2025 Ayush Singh, BeagleBoard.org
#
# SPDX-License-Identifier: Apache-2.0

CONFIG_GPIO=y
CONFIG_GPIO_GET_DIRECTION=y
CONFIG_GREYBUS_GPIO=y

CONFIG_I2C=y
CONFIG_GREYBUS_I2C=y

CONFIG_PWM=y
CONFIG_GREYBUS_PWM=y

CONFIG_SPI=y
CONFIG_GREYBUS_SPI=y

CONFIG_UART_LINE_CTRL=y
CONFIG_UART_INTERRUPT_DRIVEN=y
CONFIG_GREYBUS_UART=y

CONFIG_GREYBUS_LOOPBACK=y
CONFIG_GREYBUS_LOG_BACKEND=y

CONFIG_LED=y
CONFIG_GREYBUS_LIGHTS=y

CONFIG_FLASH=y
CONFIG_STREAM_FLASH=y
CONFIG_FLASH_MAP=y
CONFIG_BOOTLOADER_MCUBOOT=y
CONFIG_IMG_MANAGER=y
CONFIG_MCUBOOT_IMG_MANAGER=y
CONFIG_GREYBUS_FW=y
```

## samples/basic/sample.yaml
```yaml
# Copyright (c) 2025, Ayush Singh, BeagleBoard.org
# SPDX-License-Identifier: Apache-2.0

sample:
  name: greybus-basic
  description: Basic sample using greybus service

tests:
  sample.greybus.basic.transport.dummy:
    build_only: true
    sysbuild: true
    platform_allow: beagleconnect_freedom
    extra_args: EXTRA_CONF_FILE="transport-dummy.conf"

  sample.greybus.basic.transport.tcpip:
    build_only: true
    sysbuild: true
    platform_allow: beagleconnect_freedom
    extra_args: EXTRA_CONF_FILE="transport-tcpip.conf;802154-subg.conf"

  sample.greybus.basic.transport.i2c:
    build_only: true
    sysbuild: true
    platform_allow: beagleconnect_freedom
    extra_args: EXTRA_CONF_FILE="transport-i2c.conf"
```

## subsys/greybus/Kconfig
```kconfig
# Kconfig - Greybus configuration options
#
# Copyright (c) 2019 Christopher Friedt, <chrisfriedt@gmail.com>
#
# SPDX-License-Identifier: BSD-3-Clause

menuconfig GREYBUS
	bool "Greybus"
	help
	  This option enables Greybus support.

if GREYBUS

config GREYBUS_NODE
	bool "Enable greybus node support"
	default y
	help
	  This option enables functionality to act as Greybus node.

config GREYBUS_HEAP_MEM_POOL_SIZE
	int "Heap for Greybus subsystem"
	default 2048
	help
	  Heap memory pre-allocated for greybus subsystem

choice
	prompt "Which transport shall be used for Greybus?"
	default GREYBUS_XPORT_TCPIP

config GREYBUS_XPORT_TCPIP
	bool "Use the TCP/IP Transport for Greybus"
	depends on NET_TCP
	depends on NET_SOCKETS
	depends on !GREYBUS_ENABLE_TLS || (GREYBUS_ENABLE_TLS && NET_SOCKETS_SOCKOPT_TLS)
	help
	  This creates a TCP/IP service for Greybus multiplex over single socket.

config GREYBUS_XPORT_DUMMY
	bool "Use the dummy Transport for Greybus"
	help
	  This is intended for testing and tracking base greybus subsystem size.

endchoice

if GREYBUS_NODE

config GREYBUS_VENDOR_STRING
	string "Greybus Vendor String"
	default "Zephyr Project RTOS"

config GREYBUS_PRODUCT_STRING
	string "Greybus Product String"
	default "Greybus Service Sample Application"

config GREYBUS_VERSION_MAJOR
	int
	default 0

config GREYBUS_VERSION_MINOR
	int
	default 1

config GREYBUS_ENABLE_TLS
	bool "Use Transport Layer Security (TLS)"
	depends on TLS_CREDENTIALS
	help
	  Choose this option to use industry standard
	  TLS 1.2 authentication and encryption with
	  Greybus.

if GREYBUS_ENABLE_TLS

config GREYBUS_TLS_HOSTNAME
	string "The hostname to use for TLS connections"
	default "localhost"
	help
	  This is the hostname that is presented to TLS clients
	  as specified in the TLS certificate. Currently there
	  is not a convenient programmatic way to extract this
	  information from the TLS certificate at runtime, and
	  so it must be manually specified.

	  This has nothing to do with the values of
	  CONFIG_NET_HOSTNAME or CONFIG_NET_HOSTNAME_ENABLE.

choice
	prompt "How shall the Greybus server verify clients?"
	default GREYBUS_TLS_CLIENT_VERIFY_REQUIRED

config GREYBUS_TLS_CLIENT_VERIFY_NONE
	bool "No Client Verification"
	help
	  Choose this option so that Greybus never attmpts to verify
	  client credentials. This option is insecure.

	  If unsure, say N here.

config GREYBUS_TLS_CLIENT_VERIFY_OPTIONAL
	bool "Optional Client Verification"
	help
	  Choose this option so that Greybus only attmpts to verify
	  client credentials if they provide them. This option is
	  insecure.

	  If unsure, say N here.

config GREYBUS_TLS_CLIENT_VERIFY_REQUIRED
	bool "Required Client Verification"
	help
	  Choose this option so that Greybus requires clients to present
	  verifiable credentials. This is the only secure option.

	  If unsure, say Y here.
endchoice

choice
	prompt "How will TLS credentials be supplied?"
	default GREYBUS_TLS_BUILTIN

config GREYBUS_TLS_BUILTIN
	bool "Compile certificates into the application"
	help
	  This option compiles all certificates into the application
	  by converting the specified files into C arrays.
	  
	  Note, security may be compromised if an attacker has
	  physical access to the device. As such this option is insecure.
endchoice

if GREYBUS_TLS_BUILTIN
config GREYBUS_TLS_BUILTIN_CA_CERT
	string "Path to the CA certificate (for client verification)"
	depends on GREYBUS_TLS_CLIENT_VERIFY_OPTIONAL || GREYBUS_TLS_CLIENT_VERIFY_REQUIRED
	default "${ZEPHYR_BASE}/samples/net/sockets/echo_server/src/ca.der"
	help
	  The path to the Certificate Signing-Authority certificate

config GREYBUS_TLS_BUILTIN_SERVER_CERT
	string "Path to the Greybus server certificate"
	default "${ZEPHYR_BASE}/samples/net/sockets/echo_server/src/server.der"
	help
	  The path to the Greybus Server certificate (public key)

config GREYBUS_TLS_BUILTIN_SERVER_PRIVKEY
	string "Path to the Greybus server private key"
	default "${ZEPHYR_BASE}/samples/net/sockets/echo_server/src/server_privkey.der"
	help
	  The path to the Greybus Server private key

endif # GREYBUS_TLS_BUILTIN
endif # GREYBUS_ENABLE_TLS

config GREYBUS_AUDIO
	bool "Greybus Audio"
	help
	  Select this for Greybus Audio support.

config GREYBUS_CAMERA
	bool "Greybus Camera"
	help
	  Select this for Greybus Camera support.

config GREYBUS_GPIO
	bool "Greybus GPIO"
	depends on GPIO
	depends on GPIO_GET_DIRECTION
	help
	  Select this for Greybus GPIO support.

config GREYBUS_HID
	bool "Greybus HID"
	help
	  Select this for Greybus HID support.

config GREYBUS_I2C
	bool "Greybus I2C"
	depends on I2C
	help
	  Select this for Greybus I2C support.

config GREYBUS_LIGHTS
	bool "Greybus Lights"
	depends on LED
	help
	  Select this for Greybus Light support.

config GREYBUS_LOOPBACK
	bool "Greybus Loopback"
	help
	  Select this for Greybus Loopback support.

config GREYBUS_LOG_BACKEND
	bool "Greybus Log"
	help
	  Select this for Greybus log support.

config GREYBUS_POWER_SUPPLY
	bool "Greybus Power Supply"
	help
	  Select this for Greybus Power Supply support.

config GREYBUS_PWM
	bool "Greybus PWM"
	depends on PWM
	help
	  Select this for Greybus Pulse Width Modulation support.

config GREYBUS_SDIO
	bool "Greybus SDIO"
	help
	  Select this for Greybus Secure Digital IO support.

config GREYBUS_SPI
	bool "Greybus SPI"
	depends on SPI
	help
	  Select this for Greybus Serial Peripheral Interface support.

config GREYBUS_UART
	bool "Greybus UART"
	depends on SERIAL
	depends on UART_LINE_CTRL
	depends on UART_INTERRUPT_DRIVEN
	help
	  Select this for Greybus Universal Asynchronous Receiver Transmitter support.

config GREYBUS_USB
	bool "Greybus USB"
	help
	  Select this for Greybus Universal Serial Bus support.

config GREYBUS_VIBRATOR
	bool "Greybus Vibrator"
	depends on HAPTICS
	help
	  Select this for Greybus Vibrator support.

config GREYBUS_FW
	bool "Greybus Firmware Management and Donwload"
	depends on BOOTLOADER_MCUBOOT
	depends on MCUBOOT_IMG_MANAGER
	depends on IMG_MANAGER
	depends on FLASH
	depends on FLASH_MAP
	depends on STREAM_FLASH
	help
	  Select this for greybus firmware management and download support.

config GREYBUS_RAW
	bool "Greybus Raw Protocol Support"
	help
	  Select this for greybus raw protocol support.

if GREYBUS_RAW

config GREYBUS_RAW_CPORTS
	int "Number of Greybus Raw Protocol Cports"
	default 1
	help
	  The number of raw protocol cports that will be allocated.

endif # GREYBUS_RAW

config GREYBUS_SERVICE_INIT_PRIORITY
	int "default Greybus Service Init Priority"
	default 85
	range 0 99
	help
	  Greybus service init priority to ensure device initialization order.

endif # GREYBUS_NODE

module = GREYBUS
module-str = Greybus
source "subsys/logging/Kconfig.template.log_config"

endif # GREYBUS
```

## tests/greybus/integration/camera/testcase.yaml
```yaml
tests:
  integration.camera.fake:
    platform_allow:
      - native_sim
    integration_platforms:
      - native_sim
    tags: greybus
```

## tests/greybus/integration/lights/testcase.yaml
```yaml
tests:
  integration.led:
    platform_allow:
      - native_sim
    integration_platforms:
      - native_sim
    tags: test_framework
```

## tests/greybus/integration/log/testcase.yaml
```yaml
# Copyright (c) 2025, Ayush Singh, BeagleBoard.org
# SPDX-License-Identifier: Apache-2.0

tests:
  integration.log:
    platform_allow:
      - native_sim
    integration_platforms:
      - native_sim
    tags: test_framework
```

## tests/greybus/integration/pwm/testcase.yaml
```yaml
# Copyright (c) 2026, Pavithra CP, BeagleBoard.org
# SPDX-License-Identifier: Apache-2.0

tests:
  integration.pwm:
    platform_allow:
      - native_sim
    integration_platforms:
      - native_sim
    tags: greybus pwm
```

## west.yml
```yaml
# Copyright (c) 2024 Ayush Singh <ayush@beagleboard.org>
# SPDX-License-Identifier: Apache-2.0

manifest:
  self:
    west-commands: scripts/west-commands.yml

  remotes:
    - name: zephyrproject-rtos
      url-base: https://github.com/zephyrproject-rtos

  projects:
    - name: zephyr
      remote: zephyrproject-rtos
      revision: main
      import:
        name-allowlist:
          - hal_ti
          - cmsis_6
          - mcuboot
          - mbedtls
          - tf-psa-crypto
```
